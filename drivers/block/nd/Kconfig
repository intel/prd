## drivers/block/nd/Kconfig
```kconfig
menuconfig ND_DEVICES
	bool "NVDIMM Support"
	depends on PHYS_ADDR_T_64BIT
	help
	  Generic support for non-volatile memory devices including
	  ACPI-6-NFIT defined resources.  On platforms that define an
	  NFIT, or otherwise can discover NVDIMM resources, a libnd
	  bus is registered to advertise PMEM (persistent memory)
	  namespaces (/dev/pmemX) and BLK (sliding mmio window(s))
	  namespaces (/dev/ndX). A PMEM namespace refers to a memory
	  resource that may span multiple DIMMs and support DAX (see
	  CONFIG_DAX).  A BLK namespace refers to an NVDIMM control
	  region which exposes an mmio register set for windowed
	  access mode to non-volatile memory.

if ND_DEVICES

config LIBND
	tristate "LIBND: libnd device driver support"
	help
	  Platform agnostic device model for a libnd bus.  Publishes
	  resources for a PMEM (persistent-memory) driver and/or BLK
	  (sliding mmio window(s)) driver to attach.  Exposes a device
	  topology under a "ndX" bus device, a "/dev/ndctlX" bus-ioctl
	  message passing interface, and a "/dev/nmemX" dimm-ioctl
	  message interface for each memory device registered on the
	  bus.  instance.  A userspace library "ndctl" provides an API
	  to enumerate/manage this subsystem.

config ND_ACPI
	tristate "ACPI: NFIT to libnd bus support"
	select LIBND
	depends on ACPI
	help
	  Infrastructure to probe ACPI 6 compliant platforms for
	  NVDIMMs (NFIT) and register a libnd device tree.  In
	  addition to storage devices this also enables libnd craft
	  ACPI._DSM messages for platform/dimm configuration.

config ND_ACPI_DEBUG
	bool "ACPI: Extra nd_acpi debugging"
	depends on ND_ACPI
	depends on DYNAMIC_DEBUG
	default n
	help
	  Enabling this option causes the nd_acpi driver to dump the
	  input and output buffers of _DSM operations on the ACPI0012
	  device and its children.  This can be very verbose, so leave
	  it disabled unless you are debugging a hardware / firmware
	  issue.

config NFIT_TEST
	tristate "NFIT TEST: Manufactured NFIT for interface testing"
	depends on DMA_CMA
	depends on LIBND=m
	depends on ND_ACPI
	depends on m
	help
	  For development purposes register a manufactured
	  NFIT table to verify the resulting device model topology.
	  Note, this module arranges for ioremap_cache() to be
	  overridden locally to allow simulation of system-memory as an
	  io-memory-resource.

	  Note, this test expects to be able to find at least 256MB of
	  CMA space (CONFIG_CMA_SIZE_MBYTES, cma=) or it will fail to
	  load.

	  Say N unless you are doing development of the 'nd' subsystem.

config ND_E820
	tristate "E820: Support the E820-type-12 PMEM convention"
	depends on X86_PMEM_LEGACY
	default m if X86_PMEM_LEGACY
	select LIBND
	help
	  Prior to ACPI 6 some platforms advertised peristent memory
	  via type-12 e820 memory ranges.  Create a libnd bus and
	  attach an instance of the pmem driver to these ranges.

config BLK_DEV_PMEM
	tristate "PMEM: Persistent memory block device support"
	depends on LIBND
	default LIBND
	help
	  Memory ranges for PMEM are described by either an NFIT
	  (NVDIMM Firmware Interface Table, see CONFIG_NFIT_ACPI), a
	  non-standard OEM-specific E820 memory type (type-12, see
	  CONFIG_X86_PMEM_LEGACY), or it is manually specified by the
	  'memmap=nn[KMG]!ss[KMG]' kernel command line (see
	  Documentation/kernel-parameters.txt).  This driver converts
	  these persistent memory ranges into block devices that are
	  capable of DAX (direct-access) file system mappings.  See
	  Documentation/blockdev/nd.txt for more details.

	  Say Y if you want to use a NVDIMM described by ACPI, E820, etc...

config ND_BTT_DEVS
	bool

config ND_BTT
	tristate "BTT: Block Translation Table (atomic sector updates)"
	depends on LIBND 
	default LIBND
	select ND_BTT_DEVS

config ND_MAX_REGIONS
	int "Maximum number of regions supported by the sub-system"
	default 64
	---help---
	  A 'region' corresponds to an individual DIMM or an interleave
	  set of DIMMs.  A typical maximally configured system may have
	  up to 32 DIMMs.

	  Leave the default of 64 if you are unsure.

endif
```
